## meta-100ask-imx6ull/conf/distro/fsl-imx-100ask-fb.conf
```bitbake
# i.MX DISTRO for the FrameBuffer graphical backend.

include conf/distro/include/fsl-imx-100ask-base.inc
include conf/distro/include/fsl-imx-100ask-preferred-env.inc

DISTRO = "fsl-imx-100ask-fb"

# Remove conflicting backends.
DISTRO_FEATURES:remove = "x11 wayland directfb "
```
